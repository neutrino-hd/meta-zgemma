## conf/layer.conf
```bitbake
LAYERSERIES_COMPAT_zgemma = "zeus gatesgarth dunfell"

# We have a conf and classes directory, append to BBPATH
BBPATH .= ":${LAYERDIR}"

# We have a recipes directory containing .bb and .bbappend files, add to BBFILES
BBFILES += "${LAYERDIR}/recipes*/*/*.bb \
	    ${LAYERDIR}/recipes*/*/*/*.bb \
            ${LAYERDIR}/recipes*/*/*.bbappend"

BBFILE_COLLECTIONS += "zgemma"
BBFILE_PATTERN_zgemma := "^${LAYERDIR}/"
BBFILE_PRIORITY_zgemma = "6"

# Additional license settings
LICENSE_PATH += "${LAYERDIR}/files/custom-licenses"
LICENSE_PATH += "${YOCTO_BASEDIR}/meta-neutrino/custom-licenses"
LICENSE_FLAGS_WHITELIST = "commercial"
```

## conf/machine/h7.conf
```bitbake
#@TYPE: Machine
#@NAME: Zgemma h7
#@DESCRIPTION: Machine configuration for the Zgemma h7 Boxes
#@MAINTAINER: Markus Volk

require conf/machine/include/h7/default-settings.inc
require conf/machine/include/h7/tune-h7.inc

MACHINE_KERNEL_PR = "r0"

MACHINE_FEATURES = "apm usbhost keyboard vfat ext2 wifi"

MACHINE_EXTRA_RRECOMMENDS += " \
	kernel-modules \
"
##preferred versions
PREFERRED_VERSION_linux-libc-headers = "4.10"
PREFERRED_VERSION_nativesdk-linux-libc-headers = "4.10"

##preferred providers
PREFERRED_PROVIDER_virtual/kernel = "linux-zgemma"
PREFERRED_PROVIDER_virtual/neutrino = "neutrino-mp"
PREFFERED_PROVIDER_virtual/libstb-hal = "libstb-hal"
PREFFERED_PROVIDER_virtual/dvb-driver = "zgemma-dvb-modules-h7"
PREFFERED_PROVIDER_virtual/screengrabber = "grab"
PREFERRED_PROVIDER_virtual/libgles1 = "zgemma-v3ddriver-h7"
PREFERRED_PROVIDER_virtual/libgles2 = "zgemma-v3ddriver-h7"
PREFERRED_PROVIDER_virtual/egl = "zgemma-v3ddriver-h7"
```

## conf/machine/include/h7/default-settings.inc
```bitbake
# AX HD51 BSP default settings


SOC_FAMILY = "bcm7251s"

MACHINE_DRIVER ?= "h7"
MACHINE_BRAND = "ZGEMMA"
MACHINE_NAME = "h7"
IMAGEDIR = "zgemma/H7"
IMAGE_LINK = "${IMAGENAME}-h7"
MTD_ROOTFS = "mmcblk0p3"
MTD_KERNEL = "mmcblk0p2"
KERNEL_FILE = "kernel.bin"
ROOTFS_FILE = "rootfs.tar.bz2"

#IMAGE_CLASSES += "hd-emmc_image_single"
IMAGE_CLASSES += "zgemma-emmc_image_multiboot"


IMAGE_FSTYPES += "zgemma-emmc"
```
